/dts-v1/;
/plugin/;
 
/ {
    compatible = "brcm,bcm2712";
 
    fragment@0 {
        target = <&rp1_gpio>;
        __overlay__ {
            pwm_pins: pwm_pins {
                pins = "gpio18", "gpio19";
                function = "pwm0", "pwm0";
                // 重要：驱动强度设置避免信号失真
                bias-disable;
                drive-strength = <8>;
            };
        };
    };
 
    fragment@1 {
        target = <&rp1_pwm0>;
        __overlay__ {
            pinctrl-names = "default";
            pinctrl-0 = <&pwm_pins>;
            status = "okay";
            // 启用双通道模式
            #pwm-cells = <2>;
        };
    };
};